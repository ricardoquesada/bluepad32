## examples/esp32/sdkconfig.defaults.esp32
```kconfig
#
# ESP32-only options
# These Kconfig symbols are only defined when IDF_TARGET=esp32. Putting them in
# the shared sdkconfig.defaults causes "unknown kconfig symbol" warnings on
# every other target.
#
CONFIG_XTAL_FREQ_AUTO=y

# Enable Dualmode (BLE and BR/EDR)
CONFIG_BTDM_CTRL_MODE_BTDM=y
#CONFIG_BTDM_CTRL_MODE_BR_EDR_ONLY=y
# Should be, at least, one more than CONFIG_BLUEPAD32_MAX_DEVICES
# See: https://gitlab.com/ricardoquesada/bluepad32/-/issues/11
CONFIG_BTDM_CTRL_BR_EDR_MAX_ACL_CONN=5
CONFIG_BTDM_CTRL_BLE_MAX_CONN=5
CONFIG_BTDM_CTRL_BR_EDR_MAX_SYNC_CONN=0
CONFIG_BTDM_CTRL_AUTO_LATENCY=y
CONFIG_BTDM_CTRL_MODEM_SLEEP=n
```

## examples/esp32/sdkconfig.defaults.esp32c6
```kconfig
# Increase main task stack size for ESP32C6 build (eg: idf.py set-target esp32c6).
CONFIG_ESP_MAIN_TASK_STACK_SIZE=4096
```

## src/components/bluepad32/Kconfig
```kconfig
menu "Bluepad32"

    choice BLUEPAD32_PLATFORM
        bool "Target platform"
        default BLUEPAD32_PLATFORM_UNIJOYSTICLE
        help
            Select the Bluepad32 target platform.

        config BLUEPAD32_PLATFORM_AIRLIFT
            bool "AirLift"
            help
                Targets Adafruit devices that have an AirLift co-processor,
                like the Adafruit Metro M4 Express AirLift.

        config BLUEPAD32_PLATFORM_MIGHTYMIGGY
            bool "MightyMiggy"
            help
                Targets MightyMiggy device.

        config BLUEPAD32_PLATFORM_NINA
            bool "NINA"
            depends on SPI_FLASH_USE_LEGACY_IMPL
            help
                Targets Arduino devices that have the NINA co-processor,
                like the Arduino Nano RP2040 Connect.
                Requires "Component config" -> "Spi Flasher Driver" -> "Use the legacy..." to be enabled.

        config BLUEPAD32_PLATFORM_UNIJOYSTICLE
            bool "Unijoysticle"
            help
                Targets Unijoysticle 2 / Unijoysticle 2+ devices.

        config BLUEPAD32_PLATFORM_CUSTOM
            bool "Custom"
            help
                Custom platform, provided by the user/vendor

        config BLUEPAD32_PLATFORM_MAKEFILE
            bool "Decided by Makefile"
            help
                Legacy option. Defined by PLATFORM environment variable.
                Used when compiling Bluepad32 using Makefile.

    endchoice

    config BLUEPAD32_MAX_DEVICES
        int  "Maximum of connected gamepads"
        default 4
        help
        The maximum number of gamepads that can be connected at the same time.

        This limit is defined at compile-time because Bluepad32 tries not to use malloc.
        The higher the number, the more RAM it will take.

    config BLUEPAD32_GAP_SECURITY
        bool "Enable GAP Security"
        default y
        help
            When enabled, it will set GAP Security level to 2.
            This allows Nintendo Switch Pro controller to connect successfully.

            But when enabled, DualShock 3 gamepad fails to connect.

            Only disable it if you want to use DualShock 3 gamepads.

    choice BLUEPAD32_LOG_LEVEL
            bool "Log verbosity"
            default BLUEPAD32_LOG_LEVEL_INFO
            depends on !ESP_CONSOLE_NONE
            help
                Specify how much output to see in logs.

        config BLUEPAD32_LOG_LEVEL_NONE
            bool "No output"
        config BLUEPAD32_LOG_LEVEL_ERROR
            bool "Error"
        config BLUEPAD32_LOG_LEVEL_INFO
            bool "Info"
        config BLUEPAD32_LOG_LEVEL_DEBUG
            bool "Debug"
    endchoice

    config BLUEPAD32_LOG_LEVEL
        int
        default 0 if BLUEPAD32_LOG_LEVEL_NONE
        default 1 if BLUEPAD32_LOG_LEVEL_ERROR
        default 2 if BLUEPAD32_LOG_LEVEL_INFO
        default 3 if BLUEPAD32_LOG_LEVEL_DEBUG

    config BLUEPAD32_USB_CONSOLE_ENABLE
        bool "Enable USB Console"
        default  y
        depends on !ESP_CONSOLE_NONE
        help
            Enables the USB console.
            User can interact with the Bluepad32 firmware via commands.

    config BLUEPAD32_CONSOLE_NVS_COMMAND_ENABLE
        bool "Enable NVS console commands"
        default  n
        depends on BLUEPAD32_USB_CONSOLE_ENABLE
        help
            Enables the NVS console commands. Useful for debugging.

    config BLUEPAD32_ENABLE_BLE_BY_DEFAULT
        bool "Enable BLE by default (beta)"
        depends on BT_ENABLED
        default  y
        help
            Enables Bluetooth Low Energy by default.
            Needed for some mice and gamepads that only work with BLE.
            Can be overriden from the console by using the command "ble_enabled"

    config BLUEPAD32_UNIJOYSTICLE_ENABLE_SWAP_FOR_C64
        bool "Enable Swap Button on Unijoysticle2 C64"
        depends on BLUEPAD32_PLATFORM_UNIJOYSTICLE
        default y
        help
            Enables Swap button in for the Unijoysticle2 C64.
            By enabling it, if the firmware is used in the FlashParty Edition,
            then the Swap button might trigger unexpectedly.
            So, unless you are using FlashParty Edition, leave this feature enabled.

    config BLUEPAD32_MAX_ALLOWLIST
        int  "Maximum size of the Bluetooth allowlist"
        default 4
        help
        The maximum of addresses that can be inserted in the Bluetooth allowlist.

        This limit is defined at compile-time because Bluepad32 tries not to use malloc.
        The higher the number, the more RAM it will take.

    config BLUEPAD32_ENABLE_VIRTUAL_DEVICE_BY_DEFAULT
        bool "Enable Virtual Devices by default"
        default n
        help
            A Virtual Device is when a controller like DualSense or DualShock4
            supports also mouse (it is a touchpad, but converted to mouse).
            In this case the "mouse" will represent a virtual device.
            When this happends, Bluepad32 reports that two devices are connected:
            a gamepad and a mouse.
            The "gamepad device" has the "mouse virtual device" as child device.
            When the controller disconnects, or when the "gamepad device"
            is forced to disconnect then both devices will be disconnected.
            Can be overriden from the console by using the command "virtual_device_enabled"

endmenu
```

## src/components/bluepad32/Kconfig.projbuild
```kconfig
menu "Bluepad32 Configuration"

    choice BLUEPAD32_PLATFORM
        bool "Which Bluepad32 target platform"
        default BLUEPAD32_PLATFORM_UNIJOYSTICLE
        help
            Select the Bluepad32 target platform. Select "None" to define it via command line.

        config BLUEPAD32_PLATFORM_ARDUINO
            bool "Arduino"
        config BLUEPAD32_PLATFORM_NINA
            bool "Nina"
        config BLUEPAD32_PLATFORM_AIRLIFT
            bool "AirLift"
        config BLUEPAD32_PLATFORM_UNIJOYSTICLE
            bool "Unijoysticle"
        config BLUEPAD32_PLATFORM_MIGHTYMIGGY
            bool "MightyMiggy"
    endchoice

    config BLUEPAD32_GAP_SECURITY
        bool "Enable GAP Security"
        default y
        help
            When enabled, it will set GAP Security level to 2.
            This allows Nintendo Switch Pro controller to connect successfully.

            But when enabled, DualShock 3 gamepad fails to connect.

            Only disable it if you want to use DualShock 3 gamepads.
endmenu
```

## src/main/Kconfig
```kconfig
menu "Bluepad32 Custom Platform"

    choice BLUEPAD32_CUSTOM_PLATFORM
        bool "Target platform"
        default BLUEPAD32_PLATFORM_CUSTOM_1
        help
            Select the Bluepad32 target custom platform.


        config BLUEPAD32_PLATFORM_CUSTOM_1
            bool "Custom-1"
            help
                Targets "custom-1" example device.

    endchoice
endmenu
```

## src/sdkconfig.defaults
```kconfig
#
# Common options (target-agnostic)
#
# ESP32-specific knobs (XTAL frequency, BTDM controller settings) live in
# sdkconfig.defaults.esp32 because they are only defined for the original ESP32
# and produce "unknown kconfig symbol" warnings on ESP32-S3 / S2 / C3 / C6 / H2.
#
CONFIG_COMPILER_OPTIMIZATION_PERF=y

CONFIG_ESPTOOLPY_FLASHSIZE_4MB=y

# Bluetooh related
CONFIG_BT_ENABLED=y
CONFIG_BT_CONTROLLER_ONLY=y

CONFIG_ESP_COREDUMP_ENABLE_TO_FLASH=y

#
# FreeRTOS
#
# Enable FreeRTOS stats formatting functions, needed for 'tasks' console command
CONFIG_FREERTOS_USE_TRACE_FACILITY=y
CONFIG_FREERTOS_USE_STATS_FORMATTING_FUNCTIONS=y

#
# Bluepad32 options
#
CONFIG_BLUEPAD32_MAX_DEVICES=4
# Only one can be selected.
#CONFIG_BLUEPAD32_PLATFORM_AIRLIFT=y
#CONFIG_BLUEPAD32_PLATFORM_ARDUINO=y
#CONFIG_BLUEPAD32_PLATFORM_MIGHTYMIGGY=y
#CONFIG_BLUEPAD32_PLATFORM_NINA=y
#CONFIG_BLUEPAD32_PLATFORM_UNIJOYSTICLE=y

#
# BTstack options
# Needs to be disabled for ESP32-C6
# See: https://github.com/bluekitchen/btstack/issues/599
#
CONFIG_BTSTACK_AUDIO=n
```
